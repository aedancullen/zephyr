## boards/arm/nrfring_nrf52833/Kconfig
```kconfig
# NRFRING board configuration
#
# Copyright (c) 2023 Aedan Cullen <aedan@aedancullen.com>
# Copyright (c) 2021 u-blox AG
# SPDX-License-Identifier: Apache-2.0

config BOARD_ENABLE_DCDC
	bool "DCDC mode"
	select SOC_DCDC_NRF52X
	default y
	depends on BOARD_NRFRING_NRF52833
```

## boards/arm/nrfring_nrf52833/Kconfig.board
```kconfig
# NRFRING board configuration
#
# Copyright (c) 2023 Aedan Cullen <aedan@aedancullen.com>
# Copyright (c) 2021 u-blox AG
# SPDX-License-Identifier: Apache-2.0

config BOARD_NRFRING_NRF52833
	bool "nRF Ring"
	depends on SOC_NRF52833_QIAA
```

## boards/arm/nrfring_nrf52833/Kconfig.defconfig
```kconfig
# NRFRING board configuration
#
# Copyright (c) 2023 Aedan Cullen <aedan@aedancullen.com>
# Copyright (c) 2021 u-blox AG
# SPDX-License-Identifier: Apache-2.0

if BOARD_NRFRING_NRF52833

config BOARD
	default "nrfring_nrf52833"

config BT_CTLR
	default BT

endif # BOARD_NRFRING_NRF52833
```

## boards/arm/nrfring_nrf52833/nrfring_nrf52833_defconfig
```kconfig
# NRFRING board configuration
#
# Copyright (c) 2023 Aedan Cullen <aedan@aedancullen.com>
# Copyright (c) 2021 u-blox AG
# SPDX-License-Identifier: Apache-2.0

CONFIG_SOC_SERIES_NRF52X=y
CONFIG_SOC_NRF52833_QIAA=y
CONFIG_BOARD_NRFRING_NRF52833=y

# Enable MPU
CONFIG_ARM_MPU=y

# Enable hardware stack protection
CONFIG_HW_STACK_PROTECTION=y

# Enable RTT
CONFIG_USE_SEGGER_RTT=y

# enable GPIO
CONFIG_GPIO=y

# enable uart driver
CONFIG_SERIAL=y

# enable console
CONFIG_CONSOLE=y
CONFIG_UART_CONSOLE=y

# additional board options
CONFIG_GPIO_AS_PINRESET=y

CONFIG_PINCTRL=y


# RTT
CONFIG_USE_SEGGER_RTT=y
CONFIG_SHELL_BACKEND_SERIAL=n
CONFIG_SHELL_BACKEND_RTT=y


# I2C shell (as in reference)
CONFIG_GPIO=y
CONFIG_I2C=y

CONFIG_SHELL=y
CONFIG_I2C_SHELL=y


# Sensor shell (as in reference)
CONFIG_SENSOR_SHELL=y
CONFIG_SENSOR=y
CONFIG_LIS3MDL_ODR="155"
```
